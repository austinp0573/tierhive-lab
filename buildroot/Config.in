## buildroot/configs/tierhive_base_defconfig
```kconfig
# tierhive base image - buildroot defconfig
# x86_64 minimal vps image: busybox init, dropbear ssh, musl libc, grub2
#
# build with:
#   make base        (from the buildroot/ directory of this repo)
#
# to change the root password before building:
#   make menuconfig  -> system configuration -> root password
#
# note: BR2_TARGET_GENERIC_ROOT_PASSWD below is a development default.
# disable or replace it before any real deployment.

# architecture

BR2_x86_64=y

# musl is substantially smaller than glibc and has no nss framework
# threads are enabled because dropbear requires them

BR2_TOOLCHAIN_BUILDROOT_MUSL=y
BR2_TOOLCHAIN_BUILDROOT_THREADS=y
BR2_OPTIMIZE_S=y
BR2_STRIP_strip=y

# system configuration

BR2_TARGET_GENERIC_HOSTNAME="tierhive"
BR2_TARGET_GENERIC_ISSUE="tierhive"

# development root password - disable after initial access is confirmed
BR2_TARGET_GENERIC_ROOT_PASSWD="tierhive"

# console on ttyS0 (serial) for vps out-of-band console access
BR2_TARGET_GENERIC_GETTY_PORT="ttyS0"
BR2_TARGET_GENERIC_GETTY_BAUDRATE_115200=y

# use kernel devtmpfs for /dev - simplest option, correct for vps
BR2_ROOTFS_DEVICE_CREATION_DYNAMIC_DEVTMPFS=y

# rootfs overlay and build hooks
# overlay: files copied verbatim into target rootfs (init scripts, config, etc.)
# post_build.sh: permission fixups after rootfs is assembled
# post_image.sh: disk image assembly using genimage (see board/tierhive/base/)

BR2_ROOTFS_OVERLAY="$(BR2_EXTERNAL_TIERHIVE_PATH)/board/tierhive/base/rootfs_overlay"
BR2_ROOTFS_POST_BUILD_SCRIPT="$(BR2_EXTERNAL_TIERHIVE_PATH)/board/tierhive/base/post_build.sh"
BR2_ROOTFS_POST_IMAGE_SCRIPT="$(BR2_EXTERNAL_TIERHIVE_PATH)/board/tierhive/base/post_image.sh"

# kernel - 6.6 lts, stripped for kvm/virtio vps environment
# starts from the upstream x86_64_defconfig, then applies fragment
# the fragment only documents changes see board/tierhive/base/linux.config.
BR2_LINUX_KERNEL=y
BR2_LINUX_KERNEL_VERSION="6.6.31"
BR2_LINUX_KERNEL_USE_DEFCONFIG=y
BR2_LINUX_KERNEL_DEFCONFIG="x86_64"
BR2_LINUX_KERNEL_CONFIG_FRAGMENT_FILES="$(BR2_EXTERNAL_TIERHIVE_PATH)/board/tierhive/base/linux.config"

# packages

# busybox: init, shell, and core utilities in one binary.
# custom applet selection - see board/tierhive/base/busybox.config.
BR2_PACKAGE_BUSYBOX=y
BR2_PACKAGE_BUSYBOX_CONFIG="$(BR2_EXTERNAL_TIERHIVE_PATH)/board/tierhive/base/busybox.config"

# dropbear: lightweight ssh server (~110kb vs openssh ~1mb+).
# server only; the client (dbclient) is not needed on deployed systems.
BR2_PACKAGE_DROPBEAR=y
BR2_PACKAGE_DROPBEAR_DISABLE_REVERSEDNS=y

# root filesystem
# ext4, 256mb. this is the deployed rootfs size.
# the disk image itself will be slightly larger (boot partition + mbr).

BR2_TARGET_ROOTFS_EXT2=y
BR2_TARGET_ROOTFS_EXT2_4=y
BR2_TARGET_ROOTFS_EXT2_SIZE="256M"

# bootloader
# grub2 in bios/mbr mode for broadest vps provider compatibility.
# uefi is not selected; most kvm-based vps providers default to bios.

BR2_TARGET_GRUB2=y
BR2_TARGET_GRUB2_X86_BIOS=y
```

## buildroot/configs/tierhive_wireguard_defconfig
```kconfig
# tierhive wireguard image - buildroot defconfig
# extends the base image with wireguard vpn server support
#
# build with:
#   make wireguard   (from the buildroot/ directory of this repo)
#
# note: this defconfig is a copy of tierhive_base_defconfig with wireguard
# additions. if the base defconfig changes significantly, review those changes
# here as well. buildroot has no native defconfig inheritance mechanism.

# same as base

BR2_x86_64=y

BR2_TOOLCHAIN_BUILDROOT_MUSL=y
BR2_TOOLCHAIN_BUILDROOT_THREADS=y
BR2_OPTIMIZE_S=y
BR2_STRIP_strip=y

BR2_TARGET_GENERIC_HOSTNAME="tierhive-wg"
BR2_TARGET_GENERIC_ISSUE="tierhive-wg"
BR2_TARGET_GENERIC_ROOT_PASSWD="tierhive"
BR2_TARGET_GENERIC_GETTY_PORT="ttyS0"
BR2_TARGET_GENERIC_GETTY_BAUDRATE_115200=y
BR2_ROOTFS_DEVICE_CREATION_DYNAMIC_DEVTMPFS=y

# overlay: base provides core init scripts; wireguard overlay adds wg init + config
BR2_ROOTFS_OVERLAY="$(BR2_EXTERNAL_TIERHIVE_PATH)/board/tierhive/base/rootfs_overlay $(BR2_EXTERNAL_TIERHIVE_PATH)/board/tierhive/wireguard/rootfs_overlay"
BR2_ROOTFS_POST_BUILD_SCRIPT="$(BR2_EXTERNAL_TIERHIVE_PATH)/board/tierhive/base/post_build.sh"
BR2_ROOTFS_POST_IMAGE_SCRIPT="$(BR2_EXTERNAL_TIERHIVE_PATH)/board/tierhive/base/post_image.sh"

# wireguard kernel fragment adds CONFIG_WIREGUARD=m on top of the base config
BR2_LINUX_KERNEL=y
BR2_LINUX_KERNEL_VERSION="6.6.31"
BR2_LINUX_KERNEL_USE_CUSTOM_CONFIG=y
BR2_LINUX_KERNEL_CUSTOM_CONFIG_FILE="$(BR2_EXTERNAL_TIERHIVE_PATH)/board/tierhive/base/linux.config"
BR2_LINUX_KERNEL_CONFIG_FRAGMENT_FILES="$(BR2_EXTERNAL_TIERHIVE_PATH)/board/tierhive/wireguard/linux.config.fragment"
BR2_LINUX_KERNEL_INSTALL_TARGET=y
BR2_LINUX_KERNEL_NEEDS_HOST_LIBELF=y

BR2_PACKAGE_BUSYBOX=y
BR2_PACKAGE_BUSYBOX_CONFIG="$(BR2_EXTERNAL_TIERHIVE_PATH)/board/tierhive/base/busybox.config"

BR2_PACKAGE_DROPBEAR=y
BR2_PACKAGE_DROPBEAR_DISABLE_REVERSEDNS=y

# host tools
BR2_PACKAGE_HOST_E2FSPROGS=y

BR2_TARGET_ROOTFS_EXT2=y
BR2_TARGET_ROOTFS_EXT2_4=y
BR2_TARGET_ROOTFS_EXT2_SIZE="256M"

BR2_TARGET_GRUB2=y
BR2_TARGET_GRUB2_I386_PC=y
BR2_TARGET_GRUB2_BUILTIN_MODULES_PC="ext2 part_msdos"
BR2_TARGET_GRUB2_BUILTIN_CONFIG_PC="$(BR2_EXTERNAL_TIERHIVE_PATH)/board/tierhive/base/rootfs_overlay/boot/grub/grub.cfg"
# --- wireguard additions ---

# iproute2: needed for 'ip link add dev wg0 type wireguard'.
# busybox's ip applet does not support creating wireguard interface types.
BR2_PACKAGE_IPROUTE2=y

# wireguard-tools provides the 'wg' command for key generation and setconf.
# keys are never baked into the image; they are generated on the deployed system.
BR2_PACKAGE_WIREGUARD_TOOLS=y
```
